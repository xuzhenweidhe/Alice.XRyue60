/*
 * Copyright (c) 2020 Derek Schmell
 *
 * SPDX-License-Identifier: MIT
 */

#include "Alice.XRyue60.dtsi"

&kscan0 {
    col-gpios
		= <&gpio0 13 GPIO_ACTIVE_HIGH>
        , <&gpio0 24 GPIO_ACTIVE_HIGH>
		, <&gpio0 5 GPIO_ACTIVE_HIGH>
		, <&gpio1 9 GPIO_ACTIVE_HIGH>			
		, <&gpio0 31 GPIO_ACTIVE_HIGH>
		, <&gpio0 30 GPIO_ACTIVE_HIGH>
		, <&gpio0 29 GPIO_ACTIVE_HIGH>
        ;
};