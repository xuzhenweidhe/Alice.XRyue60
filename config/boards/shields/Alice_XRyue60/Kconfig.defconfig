## config/boards/shields/Alice_XRyue60/Kconfig.defconfig
```kconfig
# Copyright (c) 2020 The ZMK Contributors
# SPDX-License-Identifier: MIT

if SHIELD_Alice_XRyue60_LEFT

config ZMK_KEYBOARD_NAME
    default "Alice_XRyue60"

config ZMK_SPLIT_ROLE_CENTRAL
    default y

endif

if SHIELD_Alice_XRyue60_LEFT || SHIELD_Alice_XRyue60_RIGHT

config ZMK_SPLIT
    default y

endif
```

## config/boards/shields/Alice_XRyue60/Kconfig.shield
```kconfig
# Copyright (c) 2020 The ZMK Contributors
# SPDX-License-Identifier: MIT


config SHIELD_Alice_XRyue60_LEFT
    def_bool $(shields_list_contains,Alice_XRyue60_left)

config SHIELD_Alice_XRyue60_RIGHT
    def_bool $(shields_list_contains,Alice_XRyue60_right)
```

## config/boards/shields/xryue45/Kconfig.defconfig
```kconfig
# Copyright (c) 2020 The ZMK Contributors
# SPDX-License-Identifier: MIT

if SHIELD_xryue45

config ZMK_KEYBOARD_NAME
	default "xryue45"

endif
```

## config/boards/shields/xryue45/Kconfig.shield
```kconfig
# Copyright (c) 2020 The ZMK Contributors
# SPDX-License-Identifier: MIT

config SHIELD_xryue45
	def_bool $(shields_list_contains,xryue45)
```
